// SPDX-License-Identifier: GPL-2.0+ OR MIT
/*
 * Apple MacBook Neo, with the boot NOR in quad-lane mode at 25 MHz.
 *
 * Identical to t8140-j700.dts except for the SPI NOR bus: this is the QSPI
 * description of the t6050-gpu tree, which follows the public QSPIMC
 * binding example. The default tree keeps the single-lane 40 MHz mode the
 * NVRAM partition has been used in on the J700.
 */

#include "t8140-j700.dts"

&qspi {
	flash@0 {
		spi-max-frequency = <25000000>;
		spi-rx-bus-width = <4>;
		spi-tx-bus-width = <4>;
	};
};
